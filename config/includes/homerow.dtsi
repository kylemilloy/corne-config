#include "keys.dtsi"

#define KEYS_L  LTOP1 LTOP2 LTOP3 LTOP4 LTOP5 LMID1 LMID2 LMID3 LMID4 LMID5 LBOT1 LBOT2 LBOT3 LBOT4 LBOT5
#define KEYS_R  RTOP1 RTOP2 RTOP3 RTOP4 RTOP5 RMID1 RMID2 RMID3 RMID4 RMID5 RBOT1 RBOT2 RBOT3 RBOT4 RBOT5
#define THUMBS  LTHM1 LTHM2 LTHM3 RTHM1 RTHM2 RTHM3

#define HRML(k1,k2,k3,k4)   &htl LSHFT k1   &htl LCTRL k2   &htl LALT k3   &htl LGUI  k4
#define HRMR(k1,k2,k3,k4)   &htr RGUI  k1   &htr RALT  k2   &htr LCTL k3   &htr RSHFT k4
